## conf/layer.conf
```bitbake
# We have a conf and classes directory, add to BBPATH
BBPATH .= ":${LAYERDIR}"

# We have recipes-* directories, add to BBFILES
BBFILES += "${LAYERDIR}/recipes-*/*/*.bb \
            ${LAYERDIR}/recipes-*/*/*.bbappend \
            ${LAYERDIR}/images/*.bb"

BBFILE_COLLECTIONS += "mc"
BBFILE_PATTERN_mc := "^${LAYERDIR}/"
BBFILE_PRIORITY_mc = "6"

# This should only be incremented on significant changes that will
# cause compatibility issues with other layers
LAYERVERSION_mc = "1"
```
